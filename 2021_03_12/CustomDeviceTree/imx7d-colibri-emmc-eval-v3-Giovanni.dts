// SPDX-License-Identifier: (GPL-2.0 OR MIT)
/*
 * Copyright 2017 Toradex AG
 */

/dts-v1/;
#include "imx7d-colibri-emmc.dtsi"
#include "imx7-colibri-eval-v3.dtsi"

/ {
	model = "Giovanni Rasera, 2021 03 12, 15.04";
	compatible = "toradex,colibri-imx7d-emmc-eval-v3",
		     "toradex,colibri-imx7d-emmc", "fsl,imx7d";
};

&usbotg2 {
	vbus-supply = <&reg_usbh_vbus>;
	status = "okay";
};

&gpio5{
	status = "disabled";
};
